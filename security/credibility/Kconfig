## security/credibility/Kconfig
```kconfig
config SECURITY_CREDIBILITY
	bool "credibility support"
    default n
    help
        If you say Y here, support for credibility of subjects will be
        compiled into the kernel.
        
        If unsure, say N.
```

## security/tdm/Kconfig
```kconfig
config TDM
	bool "trust degree support"
    default n
    help
        If you say Y here, support for trust degrees of subjects will be
        compiled into the kernel.
        
        If unsure, say N.
```
